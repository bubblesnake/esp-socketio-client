## components/esp_socketio_client/examples/linux/sdkconfig.defaults
```kconfig
CONFIG_IDF_TARGET="linux"
CONFIG_IDF_TARGET_LINUX=y
CONFIG_ESP_EVENT_POST_FROM_ISR=n
CONFIG_ESP_EVENT_POST_FROM_IRAM_ISR=n
CONFIG_LOG_DEFAULT_LEVEL_DEBUG=y
CONFIG_WEBSOCKET_URI="ws://<ip>/socket.io/?EIO=4&transport=websocket"
```

## examples/target/main/Kconfig.projbuild
```kconfig
menu "Example Configuration"

    choice SOCKETIO_URI_SOURCE
        prompt "Socket.IO URI source"
        default SOCKETIO_URI_FROM_STRING
        help
            Selects the source of the URI used in the example.

        config SOCKETIO_URI_FROM_STRING
            bool "From string"

        config SOCKETIO_URI_FROM_STDIN
            bool "From stdin"
    endchoice

    config SOCKETIO_URI
        string "Socket.IO endpoint URI"
        depends on SOCKETIO_URI_FROM_STRING
        default "wss://<ip>/socket.io/?EIO=4&transport=websocket"
        help
            URL of Socket.IO endpoint this example connects to and sends echo

    config WS_OVER_TLS_SERVER_AUTH
        bool "Enable Socket.IO over TLS with Server Certificate Verification Only"
        default y
        help
            Enables Socket.IO connections over TLS (WSS) with server certificate verification.
            This setting mandates the client to verify the servers certificate, while the server
            does not require client certificate verification.

    config WS_OVER_TLS_MUTUAL_AUTH
        bool "Enable Socket.IO over TLS with Server Client Mutual Authentification"
        default n
        help
            Enables Socket.IO connections over TLS (WSS) with server and client mutual certificate verification.

    config WS_OVER_TLS_SKIP_COMMON_NAME_CHECK
        bool "Skip common name(CN) check during TLS authentification"
        default n
        help
            Skipping Common Name(CN) check during TLS(WSS) authentificatio
endmenu
```
